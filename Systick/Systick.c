/*----------------------------------------------------------------------------
		SYSTICK

*----------------------------------------------------------------------------*/

/*----------------------------------------------------------------------------
		Includes
 *----------------------------------------------------------------------------*/
 #include <TM4C129.h>

/*----------------------------------------------------------------------------
		Defines
 *----------------------------------------------------------------------------*/

#define GrupoN	(1UL << 12)

#define PN1			(1UL << 1)


/*----------------------------------------------------------------------------
		Global Variables
 *----------------------------------------------------------------------------*/
	int TimerUp;
/*----------------------------------------------------------------------------
    Functions
 *----------------------------------------------------------------------------*/
void SysTick_Handle()
{
			TimerUp++;
}

/*----------------------------------------------------------------------------
    MAIN
 *----------------------------------------------------------------------------*/
int main()
{
	
		/***********************  INIT  ***********************/
		/* Enable clock and init GPIO outputs */
		SYSCTL->RCGCGPIO |= GrupoN;  /* enable clock for GPIOs  */

		/* OUTPUTS */
		GPION->DIR	 |= PN1;  /* direcao: 0 = entrada ou 1 = saida */ 	
		GPION->DEN	 |= PN1;  /* habilita o pino */ 	

		GPION->DATA &= ~PN1;	// resetar Led 1
		
		TimerUp = 0;
		/*********************** CYCLIC ***********************/
		while(1)
		{
					if(TimerUp == 1000)
					{
						if(GPION->DATA & PN1)
						{
							GPION->DATA &= ~PN1;
						}					
						else
						{
							GPION->DATA |= PN1;
						}
				}
		} // while(1)
}
